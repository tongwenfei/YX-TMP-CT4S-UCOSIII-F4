#include "ads1248.h"
/* Private variables ---------------------------------------------------------*/
const float pt100_table[] =                                                   //PT100 0-100度对应的电阻值，0.1度间隔
{
  80.30628, 80.34599, 80.38570, 80.42541, 80.46512, 80.50483, 80.54453, 80.58424, 80.62394, 80.66364, 
  80.70334, 80.74304, 80.78273, 80.82243, 80.86212, 80.90182, 80.94151, 80.98120, 81.02089, 81.06057, 
  81.10026, 81.13994, 81.17962, 81.21931, 81.25899, 81.29866, 81.33834, 81.37802, 81.41769, 81.45736, 
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  138.1262, 138.1641, 138.2020, 138.2400, 138.2779, 138.3158, 138.3538, 138.3917, 138.4296, 138.4676,
  138.5055
};
/*******************************************************************************
* @Function Name: ADS1248_2_Delay
* @Description  : 延时 一次循环约1us
* @param		: vu32 nCount
* @retval	   	: void
* @date		   	: 2014/10/08
*******************************************************************************/
void ADS1248_Delay(vu32 nCount)
{
  u32 i, j;
  
  for(i = 0; i < nCount; i++)
  {
    for(j = 0; j < 10; j++);
  }
}
void SPI1_Init(void)
{
  GPIO_InitTypeDef GPIO_InitStructure;
  SPI_InitTypeDef  SPI_InitStructure;
  
  RCC_AHB1PeriphClockCmd(RCC_AHB1Periph_GPIOA|RCC_AHB1Periph_GPIOB|RCC_AHB1Periph_GPIOC|RCC_AHB1Periph_GPIOD|RCC_AHB1Periph_GPIOE, ENABLE);//使能GPIOA时钟
  RCC_APB2PeriphClockCmd(RCC_APB2Periph_SPI1, ENABLE);//使能SPI1时钟
  
  GPIO_InitStructure.GPIO_Pin = GPIO_Pin_4 ; 
  GPIO_InitStructure.GPIO_Mode = GPIO_Mode_IN;
  GPIO_InitStructure.GPIO_Speed = GPIO_Speed_100MHz;	 
  GPIO_InitStructure.GPIO_PuPd=GPIO_PuPd_UP;
  GPIO_Init(GPIOA, &GPIO_InitStructure);//初始化TEM2_DRDY
  
  GPIO_InitStructure.GPIO_Pin = GPIO_Pin_0 ; 
  GPIO_InitStructure.GPIO_Mode = GPIO_Mode_IN;
  GPIO_InitStructure.GPIO_Speed = GPIO_Speed_100MHz;	 
  GPIO_InitStructure.GPIO_PuPd=GPIO_PuPd_UP;
  GPIO_Init(GPIOB, &GPIO_InitStructure);//初始化TEM1_DRDY
  
  GPIO_InitStructure.GPIO_Pin = GPIO_Pin_1 ; 
  GPIO_InitStructure.GPIO_Mode = GPIO_Mode_OUT;
  GPIO_InitStructure.GPIO_Speed = GPIO_Speed_100MHz;	
  GPIO_InitStructure.GPIO_OType = GPIO_OType_PP; 
  GPIO_InitStructure.GPIO_PuPd=GPIO_PuPd_UP;
  GPIO_Init(GPIOB, &GPIO_InitStructure);//初始化TEM1_CS
  
  
  GPIO_InitStructure.GPIO_Pin = GPIO_Pin_4 |GPIO_Pin_5; 
  GPIO_InitStructure.GPIO_Mode = GPIO_Mode_OUT;
  GPIO_InitStructure.GPIO_Speed = GPIO_Speed_100MHz;	
  GPIO_InitStructure.GPIO_OType = GPIO_OType_PP; 
  GPIO_InitStructure.GPIO_PuPd=GPIO_PuPd_UP;
  GPIO_Init(GPIOC, &GPIO_InitStructure);//初始化TEM2_CS TEM2_START
  
  GPIO_InitStructure.GPIO_Pin = GPIO_Pin_11 |GPIO_Pin_12; 
  GPIO_InitStructure.GPIO_Mode = GPIO_Mode_OUT;
  GPIO_InitStructure.GPIO_Speed = GPIO_Speed_100MHz;	
  GPIO_InitStructure.GPIO_OType = GPIO_OType_PP; 
  GPIO_InitStructure.GPIO_PuPd=GPIO_PuPd_UP;
  GPIO_Init(GPIOD, &GPIO_InitStructure);//初始化TEM1_RST TEM2_RST
  
  GPIO_InitStructure.GPIO_Pin = GPIO_Pin_7 ; 
  GPIO_InitStructure.GPIO_Mode = GPIO_Mode_OUT;
  GPIO_InitStructure.GPIO_Speed = GPIO_Speed_100MHz;	
  GPIO_InitStructure.GPIO_OType = GPIO_OType_PP; 
  GPIO_InitStructure.GPIO_PuPd=GPIO_PuPd_UP;
  GPIO_Init(GPIOE, &GPIO_InitStructure);//初始化TEM1_START
  
  GPIO_SetBits(GPIOB,GPIO_Pin_1);
  GPIO_SetBits(GPIOC,GPIO_Pin_4 |GPIO_Pin_5);
  GPIO_SetBits(GPIOD,GPIO_Pin_11 |GPIO_Pin_12);
  GPIO_SetBits(GPIOE,GPIO_Pin_7);
  
  
  //GPIOF9,F10初始化设置
  GPIO_InitStructure.GPIO_Pin = GPIO_Pin_5|GPIO_Pin_6|GPIO_Pin_7;//PB3~5复用功能输出	
  GPIO_InitStructure.GPIO_Mode = GPIO_Mode_AF;//复用功能
  GPIO_InitStructure.GPIO_OType = GPIO_OType_PP;//推挽输出
  GPIO_InitStructure.GPIO_Speed = GPIO_Speed_100MHz;//100MHz
  GPIO_InitStructure.GPIO_PuPd = GPIO_PuPd_UP;//上拉
  GPIO_Init(GPIOA, &GPIO_InitStructure);//初始化
  
  GPIO_PinAFConfig(GPIOA,GPIO_PinSource5,GPIO_AF_SPI1); //PB3复用为 SPI1
  GPIO_PinAFConfig(GPIOA,GPIO_PinSource6,GPIO_AF_SPI1); //PB4复用为 SPI1
  GPIO_PinAFConfig(GPIOA,GPIO_PinSource7,GPIO_AF_SPI1); //PB5复用为 SPI1
  
  
  
  SPI_InitStructure.SPI_Direction = SPI_Direction_2Lines_FullDuplex;  //设置SPI单向或者双向的数据模式:SPI设置为双线双向全双工
  SPI_InitStructure.SPI_Mode = SPI_Mode_Master;		//设置SPI工作模式:设置为主SPI
  SPI_InitStructure.SPI_DataSize = SPI_DataSize_8b;		//设置SPI的数据大小:SPI发送接收8位帧结构
  SPI_InitStructure.SPI_CPOL = SPI_CPOL_Low;		//串行同步时钟的空闲状态为高电平
  SPI_InitStructure.SPI_CPHA = SPI_CPHA_2Edge;	//串行同步时钟的第二个跳变沿（上升或下降）数据被采样
  SPI_InitStructure.SPI_NSS = SPI_NSS_Soft;		//NSS信号由硬件（NSS管脚）还是软件（使用SSI位）管理:内部NSS信号有SSI位控制
  SPI_InitStructure.SPI_BaudRatePrescaler = SPI_BaudRatePrescaler_128;		//定义波特率预分频的值:波特率预分频值为256
  SPI_InitStructure.SPI_FirstBit = SPI_FirstBit_MSB;	//指定数据传输从MSB位还是LSB位开始:数据传输从MSB位开始
  SPI_InitStructure.SPI_CRCPolynomial = 7;	//CRC值计算的多项式
  SPI_Init(SPI1, &SPI_InitStructure);  //根据SPI_InitStruct中指定的参数初始化外设SPIx寄存器
  SPI_Cmd(SPI1, ENABLE); //使能SPI外设 
}  
/*******************************************************************************
* @Function Name: SP1_ReadWriteByte
* @Description  : Sends a byte through the SPI interface and return the byte received from the SPI bus.
* @param		: uint8_t data byte to send
* @retval	   	: uint8_t The value of the received byte
* @date		   	: 2014/10/04
*******************************************************************************/
uint8_t SP1_ReadWriteByte(uint8_t data)
{
  /* Loop while DR register in not emplty */
  while(SPI_I2S_GetFlagStatus(SPI1, SPI_I2S_FLAG_TXE) == RESET);
  
  /* Send uint8_t through the SPI bus peripheral */
  SPI_I2S_SendData(SPI1, data);
  
  /* Wait to receive a uint8_t */
  while(SPI_I2S_GetFlagStatus(SPI1, SPI_I2S_FLAG_RXNE) == RESET);
  
  /* Return the uint8_t read from the SPI bus */
  return SPI_I2S_ReceiveData(SPI1);
}
/*******************************************************************************
* @Function Name: ADS1248_ReadByte
* @Description  : Reads a byte from the SPI Device
* @param		: void
* @retval	   	: u8 Byte Read from the SPI Device
* @date		   	: 2014/10/04
*******************************************************************************/
uint8_t ADS1248_ReadByte(void)
{
  return (SP1_ReadWriteByte(ADS_NOP));
}
/*******************************************************************************
* @Function Name: ADS1248_SetIDAC
* @Description  :
* @param		: uint8_t idac1
* @param		: uint8_t idac2
* @param		: uint8_t idacImage
* @retval	   	: void
* @date		   	: 2014/10/04
*******************************************************************************/
void ADS1248_SetIDAC(uint8_t idac1, uint8_t idac2, uint8_t idacImage)
{
  SP1_ReadWriteByte(ADS_WREG | ADS_IDAC0);
  SP1_ReadWriteByte(0x01);
  SP1_ReadWriteByte(idacImage);
  SP1_ReadWriteByte(idac1 | idac2);
}
/*******************************************************************************
* @Function Name: ADS1248_SetPGAGainAndDataRate
* @Description  : Set PGA gain and data rate (SPS)
* @param		: uint8_t pgaGain
* @param		: uint8_t dataRate
* @retval	   	: void
* @date		   	: 2014/10/04
*******************************************************************************/
void ADS1248_SetPGAGainAndDataRate(uint8_t pgaGain, uint8_t dataRate)
{
  SP1_ReadWriteByte(ADS_WREG | ADS_SYS0);
  SP1_ReadWriteByte(0x00);
  SP1_ReadWriteByte(pgaGain | dataRate);
}
/*******************************************************************************
* @Function Name: ADS1248_SetBurnoutCurrentAndInputChannel
* @Description  :
* @param		: uint8_t positiveChannel
* @param		: uint8_t negativeChannel
* @retval	   	: void
* @date		   	: 2014/10/04
*******************************************************************************/
void ADS1248_SetBurnoutCurrentAndInputChannel(uint8_t burnoutCurrent, uint8_t positiveChannel, uint8_t negativeChannel)
{
  SP1_ReadWriteByte(ADS_WREG | ADS_MUX0);
  SP1_ReadWriteByte(0x00);
  SP1_ReadWriteByte(burnoutCurrent | positiveChannel | negativeChannel);
}
/*******************************************************************************
* @Function Name: ADS1248_SetReference
* @Description  :
* @param		: uint8_t interVrefOnOff
* @param		: uint8_t refSelected
* @retval	   	: void
* @date		   	: 2014/10/04
*******************************************************************************/
void ADS1248_SetReference(uint8_t interVrefOnOff, uint8_t refSelected)
{
  SP1_ReadWriteByte(ADS_WREG | ADS_MUX1);
  SP1_ReadWriteByte(0x00);
  SP1_ReadWriteByte(interVrefOnOff | refSelected);
}

/*******************************************************************************
* @Function Name: ADS1248_ReadREG
* @Description  : 读取寄存器的第byteToRead个字节
* @param		: uint8_t regName
* @param		: uint8_t byteToRead
* @retval	   	: uint8_t
* @date		   	: 2014/10/05
*******************************************************************************/
uint8_t ADS1248_ReadREG(uint8_t regName, uint8_t byteToRead)
{
  SP1_ReadWriteByte(ADS_RREG | regName);
  
  if(byteToRead == 1)
  {
    SP1_ReadWriteByte(0x00);
  }
  else if(byteToRead == 2)
  {
    SP1_ReadWriteByte(0x01);
    ADS1248_ReadByte();
  }
  
  return ADS1248_ReadByte();
}

/*******************************************************************************
* @Function Name: ADS1248_Init
* @Description  : ADS1248初始化
* @param		: void
* @retval	   	: void
* @date		   	: 2014/10/04
*******************************************************************************/
void ADS1248_Init(void)
{
 SPI1_Init();
  TEM1_RST_L();
  TEM1_START_L();
  ADS1248_Delay(4000);
  TEM1_RST_H();
  TEM1_START_H(); 
  ADS1248_Delay(20000);
  TEM1_CS_L();
  uint8_t adcreg=0;
adcreg=adcreg;
  /********                            *************************************/
  /*    检测传感器完毕，取消Burnout Current，       设置外部REF1为参考源   */
  /************************************************************************/
  
  ADS1248_SetBurnoutCurrentAndInputChannel(CURRENT_OFF, P_AIN0, N_AIN1);	                //关闭检测电流,设置传感器通道1
  adcreg=ADS1248_ReadREG(ADS_MUX0,1);
  ADS1248_SetPGAGainAndDataRate(PGAGain_4, DataRate_2000);					// 设置PGA倍数和传输速率
  adcreg=ADS1248_ReadREG(ADS_SYS0,1);
  ADS1248_SetReference(REF_Inter_AlwaysOn, SELT_REF1);					// 设置外部REF1为参考源,内部基准打开电流源才会生效
  adcreg=ADS1248_ReadREG(ADS_MUX1,1);
  
  ADS1248_Delay(10000);													                 // 等待基准源稳定
  ADS1248_SetIDAC(IDAC1_IEXT1, IDAC2_IEXT2, IMAG_1500);				         // 设置电流源为1.5mA	
  adcreg=ADS1248_ReadREG(ADS_IDAC0,1);
  TEM1_CS_H();
  
  
  TEM2_RST_L();
  TEM2_START_L();
  ADS1248_Delay(4000);
  TEM2_RST_H();
  TEM2_START_H(); 
  ADS1248_Delay(20000);
  TEM2_CS_L();
  
  /********                            *************************************/
  /*    检测传感器完毕，取消Burnout Current，       设置外部REF1为参考源   */
  /************************************************************************/
  
 ADS1248_SetBurnoutCurrentAndInputChannel(CURRENT_OFF, P_AIN0, N_AIN1);	                //关闭检测电流,设置传感器通道1
  adcreg=ADS1248_ReadREG(ADS_MUX0,1);
  ADS1248_SetPGAGainAndDataRate(PGAGain_4, DataRate_2000);					// 设置PGA倍数和传输速率
  adcreg=ADS1248_ReadREG(ADS_SYS0,1);
  ADS1248_SetReference(REF_Inter_AlwaysOn, SELT_REF1);					// 设置外部REF1为参考源,内部基准打开电流源才会生效
  adcreg=ADS1248_ReadREG(ADS_MUX1,1);
  
  ADS1248_Delay(10000);													                 // 等待基准源稳定
  ADS1248_SetIDAC(IDAC1_IEXT1, IDAC2_IEXT2, IMAG_1500);				         // 设置电流源为1.5mA	
  adcreg=ADS1248_ReadREG(ADS_IDAC0,1);
  TEM2_CS_H();
}
/*******************************************************************************
* @Function Name: ADS1248_ReadADC
* @Description  : 返回有符号数值
* @param		: void
* @retval	   	: int32_t
* @date		   	: 2014/10/04
*******************************************************************************/
int32_t ADS1248_ReadADC(ADS1248_Type adc)
{
  if(adc==TEM1)
  {
    uint8_t temp[3]={0};
    int32_t adcVal[10] = {0},tmp=0;
    int64_t val=0;
    uint32_t wait_time = 0;
    TEM1_CS_L();
    TEM1_START_H();
    for(uint8_t i=0;i<10;i++)
    {
      
      
     
      
      wait_time =  2000;                                                 //限时等待 防死机
      
      while(TEM1_DRDY() && (wait_time--) )                     //DRDY引脚高电平表示数据没准备好
      {
	;
      }                                                        
      if(wait_time == 0)                                               //超时报错
      {
	;
      }
      
      SP1_ReadWriteByte(ADS_RDATA);
      
      //进入中断                                            /* 读取数据期间禁止任务调度     */
      temp[0] = ADS1248_ReadByte();
      temp[1] = ADS1248_ReadByte();
      temp[2] = ADS1248_ReadByte();
      
      //进入中断
      
      adcVal[i] = (int32_t)(temp[0] << 24) + (temp[1] << 16) + (temp[2] << 8); // 左移8位，放大256倍识别正负号
    }
    TEM1_CS_H();
    for(uint8_t i=0;i<10;i++)
    {
      for(uint8_t j=0;j<10-i;j++)
      {
	if(adcVal[j]>adcVal[j+1])
	{
	  tmp=adcVal[j];
	  adcVal[j]=adcVal[j+1];
	  adcVal[j+1]=tmp;
	}
      }
    }
    for(uint8_t i=0;i<6;i++)
    {
      val+=adcVal[2+i];
    }
    val/=6;
    return (val >> 8);                                             // 右移8位恢复原值
  }
  else if(adc==TEM2)
  {
    uint8_t temp[3]={0};
    int32_t adcVal[10] = {0},tmp=0;
    int64_t val=0;
    uint32_t wait_time = 0;
    TEM2_CS_L();
    TEM2_START_H();
    for(uint8_t i=0;i<10;i++)
    {
      
      
     
      
      wait_time =  2000;                                                 //限时等待 防死机
      
      while(TEM2_DRDY() && (wait_time--) )                     //DRDY引脚高电平表示数据没准备好
      {
	;
      }                                                        
      if(wait_time == 0)                                               //超时报错
      {
	;
      }
      
      SP1_ReadWriteByte(ADS_RDATA);
      
      //进入中断                                            /* 读取数据期间禁止任务调度     */
      temp[0] = ADS1248_ReadByte();
      temp[1] = ADS1248_ReadByte();
      temp[2] = ADS1248_ReadByte();
      
      //进入中断
      
      adcVal[i] = (int32_t)(temp[0] << 24) + (temp[1] << 16) + (temp[2] << 8); // 左移8位，放大256倍识别正负号
    }
    TEM2_CS_H();
    for(uint8_t i=0;i<10;i++)
    {
      for(uint8_t j=0;j<10-i;j++)
      {
	if(adcVal[j]>adcVal[j+1])
	{
	  tmp=adcVal[j];
	  adcVal[j]=adcVal[j+1];
	  adcVal[j+1]=tmp;
	}
      }
    }
    for(uint8_t i=0;i<6;i++)
    {
      val+=adcVal[2+i];
    }
    val/=6;
    return (val >> 8);                                             // 右移8位恢复原值
  }
  else return -1111;
}
/*******************************************************************************
* @Function Name: ADS1248_ResToTemp
* @Description  : 二分法查表，将PT100的电阻值转为对应温度0-100
* @param		: float resistance
* @retval	   	       : float
* @date		   	: 2014/10/06
*******************************************************************************/
float ADS1248_ResToTemp(float resistance)
{
  uint16_t low = 0;
  uint16_t mid = sizeof(pt100_table) / sizeof(pt100_table[0]) / 2;
  uint16_t high = sizeof(pt100_table) / sizeof(pt100_table[0]) - 1;
  
  if((resistance < pt100_table[0]) || (resistance > pt100_table[high]))
  {
    return -100;      // 超限，不做特殊处理  返回0度
  }
  
  while(high >= low)
  {
    mid = (high + low) / 2;
    
    if(resistance >= pt100_table[mid])
    {
      if(resistance < pt100_table[mid + 1])
      {
	return (0.1 * mid + (resistance - pt100_table[mid]) * 0.1 / ((pt100_table[mid + 1]) - pt100_table[mid]))-50;
	//return ( mid + (resistance - pt100_table[mid]) / ((pt100_table[mid + 1]) - pt100_table[mid]));
      }
      else
      {
	low = mid + 1;
      }
    }
    else if(resistance < pt100_table[mid])
    {
      high = mid - 1;
    }
  }
  
  return -1; // 查找失败，不做特殊处理
}